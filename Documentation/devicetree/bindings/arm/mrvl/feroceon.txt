## Documentation/devicetree/bindings/arm/mrvl/feroceon.txt
```
* Marvell Feroceon Cache

Required properties:
- compatible : Should be either "marvell,ferocean-cache" or
  	       "marvell,kirkwood-cache".

Optional properties:
- wt-override: If present then L2 is forced to Write through mode
- reg        : Address of the L2 cache control register. Mandatory for
  	       "marvell,kirkwood-cache", not used by "marvell,ferocean-cache"


Example:
		l2: l2-cache@20128 {
			compatible = "marvell,kirkwood-cache";
			reg = <0x20128 0x4>;
		};
```

## Documentation/devicetree/bindings/arm/mrvl/forocean.txt
```
* Marvell Ferocean Cache

Required properties:
- compatible : Should be "marvell,ferocean-kirkwod".
- reg        : Address of the L2 cache control register

Optional properties:
- writethrough : only if present, the cache will be used in write through mode.

Example:
		l2: l2-cache@20128 {
			compatible = "marvell,marvell,ferocean-cache";
			reg = <0x20128 0x4>;
		};

There are at least two variants of the Ferocean, differing in how
write through is enabled or not. If mv78xx0 support is added, it is
expected to have a different compatibility string.
```

## Documentation/devicetree/bindings/arm/mrvl/foroceon.txt
```
* Marvell Feroceon Cache

Required properties:
- compatible : Should be "marvell,feroceon-kirkwood".
- reg        : Address of the L2 cache control register

Optional properties:
- writethrough : only if present, the cache will be used in write through mode.

Example:
		l2: l2-cache@20128 {
			compatible = "marvell,marvell,feroceon-kirkwood";
			reg = <0x20128 0x4>;
		};

There are at least two variants of the Feroceon, differing in how
write through is enabled or not. If mv78xx0 support is added, it is
expected to have a different compatibility string.
```

## Documentation/devicetree/bindings/ata/marvell.txt
```
* Marvell Orion SATA

Required Properties:
- compatibility : "marvell,orion-sata"
- reg           : Address range of controller
- interrupts    : Interrupt controller is using
- nr-ports      : Number of SATA ports in use.

Optional Properties:
- phys		: List of phandles to sata phys
- phy-names	: Should be "port0", "port1", etc, one per phandle

Example:

	sata@80000 {
		compatible = "marvell,orion-sata";
		reg = <0x80000 0x5000>;
		interrupts = <21>;
		phys = <&sata_phy0>, <&sata_phy1>;
		phy-names = "port0", "port1";
		nr-ports = <2>;
	}
```

## Documentation/devicetree/bindings/gpio/gpio-sx150x.txt
```
SEMTECH SX150x GPIO expander bindings


Required properties:

- compatible: should be "semtech,sx1506q",
			"semtech,sx1508q",
			"semtech,sx1509q",
			"semtech,sx1502q".

- reg: The I2C slave address for this device.

- interrupt-parent: phandle of the parent interrupt controller.

- interrupts: Interrupt specifier for the controllers interrupt.

- #gpio-cells: Should be 2. The first cell is the GPIO number and the
		second cell is used to specify optional parameters:
		bit 0: polarity (0: normal, 1: inverted)

- gpio-controller: Marks the device as a GPIO controller.

- interrupt-controller: Marks the device as a interrupt controller.

The GPIO expander can optionally be used as an interrupt controller, in
which case it uses the default two cell specifier as described in
Documentation/devicetree/bindings/interrupt-controller/interrupts.txt.

Optional properties:

- semtech,io-polarity: A bit-mask which enables polarity inversion for
  		       each IO line in the expander. Setting the bit
  		       at position n inverts the polarity of that IO
  		       line, while clearing it results in normal
  		       polarity. For chips with fewer than 16 IO pins,
  		       high-end bits are ignored.

- semtech,io-pullup:
- semtech,io-pulldown: A bit-mask which enables-or disables the
  		       pull-up (pull-down) resistor for each IO line
  		       in the expander. Setting the bit at position n
  		       will enable the pull-down for the IO at the
  		       corresponding offset.  For chips with fewer
  		       than 16 IO pins, high-end bits are ignored.

- semtech,reset-during-probe: Boolean, if true, the driver will
  			      trigger a full reset of the chip at the
  			      beginning of the probe in order to place
  			      it in a known state.

Example:

	i2c_gpio_expander@20{
		#gpio-cells = <2>;
		#interrupt-cells = <2>;
		compatible = "semtech,sx1506q";
		reg = <0x20>;
		interrupt-parent = <&gpio_1>;
		interrupts = <16 0>;

		gpio-controller;
		interrupt-controller;
	};
```

## Documentation/devicetree/bindings/input/touch.txt
```
General Touchscreen and Touchpad Properties:

Optional properties for Touchscreens:
 - touch-size-x 		: horizontal resolution of touchscreen
				 (in pixels)
 - touch-size-y 		: vertical resolution of touchscreen
				  (in pixels)
 - touch-max-pressure		: maximum reported pressure (arbitrary range
				  dependent on the controller)
 - touch-fuzz-x 		: horizontal noise value of the absolute input
				  device (in pixels)
 - touch-fuzz-y 		: vertical noise value of the absolute input
				  device (in pixels)
 - touch-fuzz-pressure		: pressure noise value of the absolute input
				  device (arbitrary range dependent on the
				  controller)
 - touch-inverted-x		: X axis is inverted (boolean)
 - touch-inverted-y		: Y axis is inverted (boolean)
 - touch-swapped-x-y		: X and Y axis are swapped (boolean)
				  Swapping is done after inverting the axis

Deprecated properties for Touchscreens:
 - x-size			: deprecated name for touch-size-x
 - y-size			: deprecated name for touch-size-y
 - moving-threshold		: deprecated name for a combination of
				  touch-fuzz-x and touch-fuzz-y
 - contact-threshold		: deprecated name for touch-fuzz-pressure
 - x-invert			: deprecated name for touch-inverted-x
 - y-invert			: deprecated name for touch-inverted-y
```

## Documentation/devicetree/bindings/input/touchscreen/egalax-ts.txt
```
* EETI eGalax Multiple Touch Controller

Required properties:
- compatible: must be "eeti,egalax_ts"
- reg: i2c slave address
- interrupts: touch controller interrupt
- wakeup-gpios: the gpio pin to be used for waking up the controller
  and also used as irq pin

Optional properties:
- eeti,protocol-version: protocol version used by the controller
	0: This is the default protocol used when the property is absent. This
	protocol supports up to 5 touch points with 1 points per report.
	1: Protocol supports up to 10 touch points with a maximum of 5 points
	per report.

Example:

	touchscreen@4 {
		compatible = "eeti,egalax_ts";
		reg = <0x04>;
		interrupt-parent = <&gpio1>;
		interrupts = <9 2>;
		wakeup-gpios = <&gpio1 9 0>;
		eeti,protocol-version = <1>;
	};
```

## Documentation/devicetree/bindings/net/dsa/broadcom.txt
```
* Broadcom Starfighter 2 integrated switch device

Required properties:

- compatible: should be "brcm,brcm-sf2"
- reg: addresses and length of the register sets for the device, must be 6
  pairs of register addresses and lengths
- interrupts: interrupts for the devices, must be two interrupts

Optional properties:

- reg-names: litteral names for the device base register addresses,
  when present must be: "core", "reg", "intrl2_0", "intrl2_1", "fcb",
  "acb"

- interrupt-names: litternal names for the device interrupt lines,
  when present must be: "switch_0" and "switch_1"

- brcm,num-gphy: specify the maximum number of integrated gigabit PHYs
  in the switch

- brcm,num-rgmii-ports: specify the maximum number of RGMII interfaces
  supported by the switch

- brcm,fcb-pause-override: boolean property, if present indicates that
  the switch supports Failover Control Block pause override capability

- brcm,acb-packets-inflight: boolean property, if present indicates
  that the switch Admission Control Block supports reporting the
  number of packets in-flight in a switch queue

Example:

	switchdev0: switchdev0 {
		compatible = "brcm,brcm-sf2";
		reg = <0x0 0x40000
			0x40000 0x110
			0x40340 0x30
			0x40380 0x30
			0x40400 0x34
			0x40600 0x208>;
		interrupts = <0 0x18 0
				0 0x19 0>;
		brcm,num-gphy = <1>;
		brcm,num-rgmii-ports = <2>;
		brcm,fcb-pause-override;
		brcm,acb-packets-inflight;
	};
```

## Documentation/devicetree/bindings/net/dsa/marvell.txt
```
Marvell DSA Switch Device Tree Bindings
---------------------------------------

Required properties:
- compatible		: Should be one of "marvell,mv88e6123",
			  "marvell,mv88e6131", "marvell,mv88e6171",
			  "marvell,mv88e6352" or "marvell,mv88e6060"
- mii-bus		: phandle to MII bus the switch is on
- addr			: Address on the MII bus for the switch

Example:

	switchdev0: switchdev0 {
		compatible = "marvell,mv88e6352";
		mii-bus = <&mdio_mux_1>;
		addr = <0>;
	};
```

## Documentation/devicetree/bindings/nvmem/zii,rave-sp-eeprom.txt
```
Zodiac Inflight Innovations RAVE EEPROM Bindings

RAVE SP EEPROM device is a "MFD cell" device exposing physical EEPROM
attached to RAVE Supervisory Processor. It is expected that its Device
Tree node is specified as a child of the node corresponding to the
parent RAVE SP device (as documented in
Documentation/devicetree/bindings/mfd/zii,rave-sp.txt)

Required properties:

- compatible: Should be "zii,rave-sp-eeprom"

Example:

	rave-sp {
		compatible = "zii,rave-sp-rdu1";
		current-speed = <38400>;

		main-eeprom {
			compatible = "zii,rave-sp-eeprom";
			reg = <0xA4 0x4000>;
			#address-cells = <1>;
			#size-cells = <1>;

			wdt_timeout: wdt-timeout@81 {
				reg = <0x81 2>;
			};
		};
	}
```

## Documentation/devicetree/bindings/phy/phy-mvebu-pcie.txt
```
* Marvell MVEBU PCIe PHY

Power control for the PCIe phy found on Marvell MVEBU SoCs.

This document extends the binding described in phy-bindings.txt

Required properties :

 - reg             : Offset and length of the register set for the PCIe device
 - compatible      : Should be "marvell,mvebu-pcie-phy"
 - clocks	   : phandle of clock that supplies the PCIe device
 - clock-names	   : Should be "pcie"

Example:
		pcie-phy@0 {
			compatible = "marvell,mvebu-pcie-phy";
			reg = <0x40000 0x1a08>;
			clocks = <&gate_clk 2>;
			clock-names = "sata";
			#phy-cells = <1>;
			status = "ok";
		};
```

## Documentation/devicetree/bindings/power/fsl,imx-gpcv2.txt
```
Freescale i.MX General Power Controller v2
==========================================

The i.MX7S/D General Power Control (GPC) block contains Power Gating
Control (PGC) for various power domains.

Required properties:

- compatible: Should be "fsl,imx7d-gpc"

- reg: should be register base and length as documented in the
  datasheet

- interrupts: Should contain GPC interrupt request 1

- pcie-phy-supply: Link to the LDO regulator powering the PCIE PHY
  power domain (connected to PCIE_VP/VP_TX/VP_RX pads)

- mipi-phy-supply: Link to the LDO regulator powering the MIPI PHY
  power domain (connected to VDD_MIPI_1P0 pad)

- usb-hsic-phy-supply: Link to the LDO regulator powering the USB HSIC
  PHY power domain (connected to VDD_USB_H_1P2 pad)

- #power-domain-cells: Should be 1, see below:

The gpc node is a power-controller as documented by the generic power
domain bindings in
Documentation/devicetree/bindings/power/power_domain.txt.

Example:

	gpc: gpc@303a0000 {
		compatible = "fsl,imx7d-gpc";
		reg = <0x303a0000 0x10000>;
		interrupt-controller;
		interrupts = <GIC_SPI 87 IRQ_TYPE_LEVEL_HIGH>;
		#interrupt-cells = <3>;
		interrupt-parent = <&intc>;
		#power-domain-cells = <1>;
		pcie-phy-supply = <&reg_1p0d>;
	};


Specifying power domain for IP modules
======================================

IP cores belonging to a power domain should contain a 'power-domains'
property that is a phandle pointing to the gpc device node and a
DOMAIN_INDEX specifying the power domain the device belongs to.

Example of a device that is part of the PU power domain:

	pcie: pcie@0x33800000 {
	      reg = <0x33800000 0x4000>,
	            <0x4ff00000 0x80000>;
		/* ... */
		power-domains = <&gpc IMX7_POWER_DOMAIN_PCIE_PHY>;
		/* ... */
	};

All valid DOMAIN_INDEX values are defined and can be found in
include/dt-bindings/power/imx7-power.h
```

## Documentation/devicetree/bindings/reset/fsl,imx7-src.txt
```
Freescale i.MX7 System Reset Controller
======================================

Please also refer to reset.txt in this directory for common reset
controller binding usage.

Required properties:
- compatible: Should be "fsl,imx7-src", "syscon"
- reg: should be register base and length as documented in the
  datasheet
- interrupts: Should contain SRC interrupt
- #reset-cells: 1, see below

example:

src: src@30390000 {
     compatible = "fsl,imx7d-src", "syscon";
     reg = <0x30390000 0x10000>;
     interrupts = <GIC_SPI 89 IRQ_TYPE_LEVEL_HIGH>;
     #reset-cells = <1>;
};


Specifying reset lines connected to IP modules
==============================================

The system reset controller can be used to reset various set of
peripherals. Device nodes that need access to reset lines should
specify them as a reset phandle in their corresponding node as
specified in reset.txt.

Example:

	pcie: pcie@0x33800000 {

		...

		resets = <&src IMX7_RESET_PCIEPHY>,
			 <&src IMX7_RESET_PCIE_CTRL_APPS>;
		reset-names = "pciephy", "apps";

		...
        };


For list of all valid reset indicies see
<dt-bindings/reset/imx7-reset.h>
```

## drivers/net/dsa/mv88e6xxx/Kconfig
```kconfig
config NET_DSA_MV88E6XXX
	tristate "Marvell 88E6xxx Ethernet switch fabric support"
	depends on NET_DSA
	select NET_DSA_TAG_EDSA
	select NET_DSA_TAG_DSA
	help
	  This driver adds support for most of the Marvell 88E6xxx models of
	  Ethernet switch chips, except 88E6060.

config NET_DSA_MV88E6XXX_TCAM
	bool "Marvell 88E6xxx Ethernet switch TCAM support"
	default y
	depends on NET_DSA_MV88E6XXX
	help
	  Enable support for the TCAM which some switch chips have. The TCAM
	  can be used to accelerate frame filtering.
```
