/*
 * Nodes which are common to all Synology devices
 *
 * Andrew Lunn <andrew@lunn.ch>
 *
 * This file is licensed under the terms of the GNU General Public
 * License version 2.  This program is licensed "as is" without any
 * warranty of any kind, whether express or implied.
 */

/ {
	mbus {
		pcie-controller {
			pcie@2,0 {
				status = "okay";
			};
		};
	};
};