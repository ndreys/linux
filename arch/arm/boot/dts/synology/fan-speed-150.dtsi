/*
 * Andrew Lunn <andrew@lunn.ch>
 *
 * This file is licensed under the terms of the GNU General Public
 * License version 2.  This program is licensed "as is" without any
 * warranty of any kind, whether express or implied.
 */

/ {
	gpio_fan {
		gpio-fan,speed-map = <    0 0
				       2200 1
				       2500 2
				       3000 4
				       3300 3
				       3700 5
				       3800 6
				       4200 7 >;
	};
};